/**
 * @file main.c
 * @author your name (you@domain.com)
 * @brief Programación para la identificación del sistema FLYWHEEL INVERTED PENDULUM
 * @version 0.1
 * @date 2024-08-14
 * 
 * @copyright Copyright (c) 2024
 * 
 */
/**
 * @file main.c
 * @author your name (you@domain.com)
 * @brief Programación para la identificación del sistema FLYWHEEL INVERTED PENDULUM
 * @version 0.1
 * @date 2024-08-14
 * 
 * @copyright Copyright (c) 2024
 * 
 */

#include <stdio.h>
#include <freertos/FreeRTOS.h>
#include <freertos/task.h>
#include "encoder.h"
#include "pwm_control.h"
#include "esp_timer.h"
#include "math.h"

// Variables
int prbs_sequence[1000] = {1, 1, 1, -1, -1, 1, 1, 1, -1, 1, 1, 1, -1, 1, 1, -1, 1, 1, -1, 
1, -1, 1, -1, -1, 1, -1, -1, -1, -1, 1, 1, -1, -1, 1, -1, 1, 1, 1, 1, -1, 1, 1, 1, 1, 1, 
-1, 1, 1, -1, -1, 1, -1, 1, 1, 1, 1, -1, -1, 1, 1, 1, 1, 1, 1, -1, 1, 1, -1, 1, 1, -1, 1, 
-1, -1, -1, -1, -1, 1, -1, -1, -1, 1, -1, 1, 1, 1, -1, 1, 1, -1, -1, -1, 1, -1, 1, 1, 1, -1, 
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-1, -1, 1, -1, 1, 1, 1, 1, -1, 1, 1, 1 
};
int prbs_index = 0;
int encoder_value[1000] = {0};
int new_frequency = 0;
int index_encoder = 0;

void app_main(void){
    encoder_init();
    mcpwm_init();
    TickType_t xLastWakeTime;
    bool finalizado = false;
    xLastWakeTime = xTaskGetTickCount();
    while (true){
        if (!finalizado){ 
            printf("Index PRBS: %d | Index Encoder: %d\n", prbs_index, index_encoder);
            // Inyecta la señal PRBS al motor
            if(prbs_sequence[prbs_index] == 1){
                motor_forward();
            } else {
                motor_backward();
            }
            prbs_index = (prbs_index + 1) % 1000;
            mcpwm_set_value_to_compare(1000);
            
            // Lee la posición del sensor
            encoder_value[index_encoder] = read_as5600_position();
            index_encoder = (index_encoder + 1) % 1000;
            
            // Espera para el próximo ciclo
            vTaskDelayUntil(&xLastWakeTime, pdMS_TO_TICKS(10)); 
            
            // Verifica si se ha completado la captura de datos
            if (index_encoder == 0){
                finalizado = true;
            }
        } else {     
            printf("INICIO\n");
            for (int i = 0; i < 1000; i++){
                printf("%d\n", encoder_value[i]);
                vTaskDelay(pdMS_TO_TICKS(10));
            }
            printf("FIN\n");
            break; // Sale del bucle después de imprimir los datos
        }
    }
}
