/**
 * @file main.c
 * @author your name (you@domain.com)
 * @brief Programación para la identificación del sistema FLYWHEEL INVERTED PENDULUM
 * @version 0.1
 * @date 2024-08-14
 * 
 * @copyright Copyright (c) 2024
 * 
 */
/**
 * @file main.c
 * @author your name (you@domain.com)
 * @brief Programación para la identificación del sistema FLYWHEEL INVERTED PENDULUM
 * @version 0.1
 * @date 2024-08-14
 * 
 * @copyright Copyright (c) 2024
 * 
 */

#include <stdio.h>
#include <freertos/FreeRTOS.h>
#include <freertos/task.h>
#include "encoder.h"
#include "pwm_control.h"
#include "esp_timer.h"
#include "math.h"

// Defines
#define INDEX               2046
#define SAMPLE_TIME_US      100000
#define DUTY_CYCLE          1000

// Variables
int prbs_sequence[INDEX] = {-1,-1,-1,-1,-1,-1,-1,-1,-1,-1,1,1,1,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1
};
int encoder_value[INDEX] = {0};
int prbs_index = 0;
int new_frequency = 0;

// handles
esp_timer_handle_t timer_handle;

// functions
void timer_callback(void* arg);
void print_values();

void app_main(void){
    encoder_init();
    mcpwm_init();
    mcpwm_set_value_to_compare(DUTY_CYCLE);
    // Configure timer
    esp_timer_create_args_t timer_args = {
        .callback = &timer_callback,
        .arg = NULL,
        .dispatch_method = ESP_TIMER_TASK,
        .name = "PID Timer"
    };
    esp_timer_create(&timer_args, &timer_handle);
    vTaskDelay(pdMS_TO_TICKS(5000));
    ESP_ERROR_CHECK(esp_timer_start_periodic(timer_handle, SAMPLE_TIME_US));
    printf("Timer started\n");

    while (true){
        // Verifica si se ha completado la captura de datos
        if(!esp_timer_is_active(timer_handle)) {
            printf("Timer stopped\n");
            print_values();
            break; // Sale del bucle después de imprimir los datos
        }
    }
}

void timer_callback(void* arg){
    if (prbs_index == INDEX){
        esp_timer_stop(timer_handle);
        motor_stop();
        mcpwm_set_value_to_compare(0);
        return;
    }
    // Inyecta la señal PRBS al motor
    if(prbs_sequence[prbs_index] > 0){
        motor_backward();
    } else {
        motor_forward();
    }
    
    // Lee la posición del sensor
    encoder_value[prbs_index] = read_as5600_position();
    prbs_index++;    
}

void print_values(){
    printf("INICIO\n");
    for (int i = 0; i < INDEX; i++){
        printf("%d\n", encoder_value[i]);
        vTaskDelay(pdMS_TO_TICKS(10));
    }
    printf("FIN\n");
}